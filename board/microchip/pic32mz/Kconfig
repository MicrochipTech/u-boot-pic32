## board/microchip/pic32mz/Kconfig
```kconfig
if TARGET_PIC32MZ

config SYS_SOC
	default "pic32"

config SYS_BOARD
	default "pic32mz"

config SYS_VENDOR
	default "microchip"

config SYS_CONFIG_NAME
	default "pic32mzsk"

endif
```

## configs/pic32mzdask_defconfig
```kconfig
CONFIG_MIPS=y
CONFIG_TARGET_PIC32MZDASK=y
CONFIG_SYS_LITTLE_ENDIAN=y
CONFIG_HUSH_PARSER=y
CONFIG_SYS_HUSH_PARSER=y
CONFIG_CMD_NET=y
# CONFIG_CMD_TFTPPUT is not set
CONFIG_CMD_TIME=y
# CONFIG_CMD_FPGA is not set
```
